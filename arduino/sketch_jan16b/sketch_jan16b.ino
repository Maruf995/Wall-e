#include "Servo.h"

Servo servo1; // Объект для первого серво (пин 11)
Servo servo2; // Объект для второго серво (пин 9)
int angle1 = 180; // Начальное положение первого серво
bool isStopped = false; // Флаг для остановки

void setup() {
  servo1.attach(11); // Пин для подключения первого серво
  servo2.attach(9);  // Пин для подключения второго серво
  servo1.write(angle1); // Устанавливаем начальное положение первого серво
  servo2.write(90);      // Устанавливаем начальное положение второго серво
  Serial.begin(9600);   // Для получения команд из Python
}

void loop() {
  if (Serial.available() > 0) {
    String command = Serial.readStringUntil('\n'); // Считываем команду до конца строки

    if (command == "STOP") { // Специальная команда для остановки
      isStopped = true; // Устанавливаем флаг
      return; // Выходим из loop
    }

    if (command == "ROTATE_9") { // Команда для поворота второго серво на 180 градусов
      servo2.write(170); // Поворачиваем второй серво на 180 градусов
      delay(2000);        // Ждем завершения поворота
      servo2.write(90); // Поворачиваем второй серво на 180 градусов
      delay(500);      
      servo1.write(170); // Поворачиваем второй серво на 180 градусов
      delay(200);        // Ждем завершения поворота
      servo1.write(90); // Поворачиваем второй серво на 180 градусов
      delay(200);      
      return;              // Возвращаемся к началу loop
    }

  }
}